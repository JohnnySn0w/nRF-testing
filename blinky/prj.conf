## CMakeLists.txt
```
# SPDX-License-Identifier: Apache-2.0

cmake_minimum_required(VERSION 3.20.0)
find_package(Zephyr REQUIRED HINTS $ENV{ZEPHYR_BASE})
project(blinky)

target_sources(app PRIVATE src/main.c src/callbacks.c src/vcnl4040.c src/gpioDev.c src/flags.c src/remoteService/remote.c)

zephyr_library_include_directories(src/remoteService)
```

## prj.conf
```kconfig
CONFIG_I2C=y
CONFIG_GPIO=y
CONFIG_PRINTK=y
# CONFIG_GPIO=n
# CONFIG_NRFX_GPIOTE=y

# For Bluetooth
CONFIG_BT=y
CONFIG_BT_PERIPHERAL=y
CONFIG_BT_DEVICE_NAME="MISTRAL DK"
CONFIG_BT_DEVICE_APPEARANCE=0
CONFIG_BT_MAX_CONN=1
CONFIG_BT_LL_SOFTDEVICE=y
```

## nrf52dk_nrf52832.overlay
```dts
// To get started, press Ctrl+Space (or Option+Esc) to bring up the completion menu and view the available nodes.

// You can also use the buttons in the sidebar to perform actions on nodes.
// Actions currently available include:

// * Enabling / disabling the node
// * Adding the bus to a bus
// * Removing the node
// * Connecting ADC channels

// For more help, browse the DeviceTree documentation at https://docs.zephyrproject.org/latest/guides/dts/index.html
// You can also visit the nRF DeviceTree extension documentation at https://nrfconnect.github.io/vscode-nrf-connect/devicetree/nrfdevicetree.html
&i2c1 {
    status="okay";
    compatible = "nordic,nrf-twim";
    label = "I2C_1";
};
```

## nrf5340dk_nrf5340_cpuapp.overlay
```dts
&i2c1 {
		status="okay";
		compatible = "nordic,nrf-twim";
		label = "I2C_1";
		// clock-frequency = <100000>;
		// vcnl40401: vcnl4040@60 {
		//     status = "okay";
		// 	compatible = "vishay,vcnl4040";//vishay?
		// 	reg = <0x60>;
		// };
	// };
	// interrupt {
	// 	compatible = "nordic,nrf-gpio";
	// 	int_pin: NRF_PIN_POS {
	// 		compatible = "nordic,nrf-gpio";
	// 		gpios=<&arduino_header connector-0 connector-1>
	// 	};
	// };

};
```

## src/main.c
```c
/*
 * Copyright (c) 2022 Michael Mahan
 *
 */
#include <zephyr/sys/printk.h>
#include <zephyr/kernel.h>
#include <zephyr/device.h>
#include "vcnl4040.h"
#include "gpioDev.h"
#include "callbacks.h"
#include "remoteService/remote.h"
// #include <nrfx_gpiote.h>


#define SLEEPTIME				2000
extern bool sleepFlag;
extern bool bleConnFlag;

struct bt_conn_cb bluetooth_callbacks = {
    .connected = on_connected,
    .disconnected = on_disconnected,
};

struct bt_account_service_cb account_service_callbacks = {
	.data_received = on_data_received,
};

// struct intFlags {
// 	0b10000000: Reserved,
// 	0b1000000: PS_SPFLAG, //PS entering protection mode
// 	0b100000: ALS_IF_L, //ALS crossing low THD INT trigger event 8192
// 	0b10000: ALS_IF_H, //ALS crossing high THD INT trigger event 4096
// 	0b1000: Reserved,
// 	0b100: Reserved,
// 	0b10: PS_IF_CLOSE, PS rises above PS_THDH INT trigger event
// 	0b1: PS_IF_AWAY //PS drops below PS_THDL INT trigger event
// };

void main(void)
{
	const struct device *dev = DEVICE_DT_GET(DT_NODELABEL(i2c0));
	const struct device *gp_cont = DEVICE_DT_GET(DT_NODELABEL(gpio0));
	uint8_t i2c_buffer[3];
	
	if(!sensorSetup(dev, i2c_buffer)) 
	{
		return;
	}

	if(!setupGPIO(gp_cont))
	{
		return;
	}
	// bluetooth_callbacks;
	if(!bluetoothInit(&bluetooth_callbacks, &account_service_callbacks))
	{
		return;
	}
	
	//create and start minute countdown
	createTimer();
	startTimer();
	vcnlRead(dev, i2c_buffer, VCNL4040_INT_FLAG);//primes int pin, otherwise locks in int state
	while(true)
	{
		if(!sleepFlag)
		{
			pollALS(dev, i2c_buffer);
			k_msleep(SLEEPTIME);
		}
		// } else {bluetoothDisable();}
		k_msleep(SLEEPTIME); //prevents loop from locking?
	}
}
```

## src/BLE.h
```c
#ifndef BLE_H_
#define BLE_H_

#include <zephyr/drivers/gpio.h>

void proxyBLE(const struct device *gpioButton, struct gpio_callback *callback, gpio_port_pins_t pins);

#endif
```

## src/callbacks.c
```c
#include "callbacks.h"

#define AMBIENT_COUNTDOWN		10
struct k_timer ambientTimer;
extern bool buttonFlag;
extern bool sleepFlag; 
extern bool INTflag;

void proxyBLE(const struct device *gpioButton, struct gpio_callback *callback, gpio_port_pins_t pins)
{
	buttonFlag = !buttonFlag;
}

void int_triggered(const struct device* dev, struct gpio_callback* callb, uint32_t pin)
{
	INTflag = true;
	sleepFlag = false;
	startTimer();
}

void sleepFuncCb(struct k_timer *dummy)
{
	sleepFlag = true; 
	//put device into sleep mode, waiting for interrupt
}

void createTimer()
{
    k_timer_init(&ambientTimer, sleepFuncCb, NULL);
}

void startTimer()
{
	k_timer_start(&ambientTimer, K_SECONDS(AMBIENT_COUNTDOWN),K_SECONDS(0));
}
```

## src/callbacks.h
```c
#ifndef CB_H_
#define CB_H_

#include <zephyr/drivers/gpio.h>




void proxyBLE(const struct device *gpioButton, struct gpio_callback *callback, gpio_port_pins_t pins);

void int_triggered(const struct device* dev, struct gpio_callback* callb, uint32_t pin);

void sleepFuncCb(struct k_timer *dummy);

void createTimer();

void startTimer();

#endif
```

## src/flags.c
```c
#ifndef FLAGS_H_
#define FLAGS_H_
//global flags
#include <stdbool.h>

bool INTflag = false;
bool buttonFlag = false;
bool sleepFlag = false;
bool bleConnFlag = false;
int operatingStatus = 1;

#endif
```

## src/gpioDev.c
```c
#include <zephyr/drivers/gpio.h>
#include "gpioDev.h"
#include "callbacks.h"

bool setupGPIO(const struct device* gp_cont)
{
	int ret; 
	printk("setting up gpio\n");
	if (!device_is_ready(gp_cont))
	{
		printk("GPIO not ready.\n");
		return false;
	} 
	else
	{
		ret = gpio_pin_configure(gp_cont, INT_PIN, INT_PIN_CONFIG);
		if(ret != 0)
		{ 
			printk("Error %d: failed to configure INT pin\n", ret);
			return false;
		}
		ret = gpio_pin_configure_dt(&button3_spec, GPIO_INPUT);
		if(ret != 0)
		{ 
			printk("Error %d: failed to configure button pin\n", ret);
			return false;
		}
	}
	ret = gpio_pin_interrupt_configure(gp_cont, INT_PIN, GPIO_INT_LOW_0);
	if(ret != 0) 
	{
		printk("Error %d: failed to configure interrupt for pin %d\n", ret, INT_PIN);
		return false;
	} 
	ret = gpio_pin_interrupt_configure_dt(&button3_spec, GPIO_INT_EDGE_TO_ACTIVE);
	if(ret != 0) 
	{
		printk("Error %d: failed to configure interrupt for pin %d\n", ret, button3_spec.pin);
		return false;
	}
	//int pin setup
	static struct gpio_callback interrupt_callback_data;
	gpio_init_callback(&interrupt_callback_data, int_triggered, BIT(INT_PIN));
	gpio_add_callback(gp_cont, &interrupt_callback_data);
	//button setup
	static struct gpio_callback button3_pressed;
	gpio_init_callback(&button3_pressed, proxyBLE, BIT(button3_spec.pin));
	gpio_add_callback(button3_spec.port, &button3_pressed);
	return true;
}
```

## src/gpioDev.h
```c
#ifndef GPIODEV_H_
#define GPIODEV_H_

#include <zephyr/drivers/gpio.h>

#define BUTTON3					DT_NODELABEL(button3)
#define INT_PIN					4
#define INT_PIN_CONFIG			(GPIO_INPUT|GPIO_ACTIVE_HIGH|GPIO_INT_ENABLE|GPIO_PULL_UP)

static const struct gpio_dt_spec button3_spec = GPIO_DT_SPEC_GET(BUTTON3, gpios);

bool setupGPIO(const struct device* gp_cont);

#endif 
```

## src/vcnl4040.c
```c
#include <zephyr/sys/printk.h>
#include <zephyr/drivers/i2c.h>
#include "vcnl4040.h"

extern bool buttonFlag;
extern bool INTflag;

bool vcnlWrite(const struct device* dev, uint8_t* i2c_buffer, bufMsg* msg)
{
	i2c_buffer[0] = msg->regAddr;
	i2c_buffer[1] = msg->LByte;
	i2c_buffer[2] = msg->HByte;
	int error = i2c_write(dev, i2c_buffer, 3, VCNL4040_I2C_ADDR);
	if(error < 0)
	{
		printk("error with write %d, to address: %X!\n", error, msg->regAddr);
		return false;
	}
	return true;
}

bool vcnlRead(const struct device* dev, uint8_t* i2c_buffer, uint8_t reg)
{
	int error; 
	//set read to als register
	i2c_buffer[0] = reg;
	error = i2c_write_read(dev, VCNL4040_I2C_ADDR, i2c_buffer, 1, i2c_buffer, 2);
	if(error < 0)
	{
		printk("error with read %d!\n", error);
		return false;
	}

	printk("Reading from channel %X: %u\n", reg, (i2c_buffer[1]<<8) + (i2c_buffer[0]));
	return true;
}


bool sensorSetup(const struct device* dev, uint8_t* i2c_buffer) 
{
	if (!device_is_ready(dev)) 
	{
		// No such node, or the node does not have status "okay". 
		printk("\nError: no device found.\n");
		return false;
	} 
	printk("setting up sensor\n");
	bufMsg msg;
	msg.regAddr = VCNL4040_ALS_CONF_REG; //send to als config command
	msg.LByte = VCNL4040_ALS_CONF_SET_L; //low byte
	msg.HByte = VCNL4040_ALS_CONF_SET_H; //high byte unneccessary
	//config thru i2c, set initial conifg for als to be on and such
	if(!vcnlWrite(dev, i2c_buffer, &msg))
	{return false;}

	msg.regAddr = VCNL4040_H_THRESH_REG;
	msg.LByte = VCNL4040_H_THRESH_L;
	msg.HByte = VCNL4040_H_THRESH_H;
	if(!vcnlWrite(dev, i2c_buffer, &msg))
	{return false;}

	msg.regAddr = VCNL4040_L_THRESH_REG;
	msg.LByte = VCNL4040_L_THRESH_L;
	msg.HByte = VCNL4040_L_THRESH_H;
	if(!vcnlWrite(dev, i2c_buffer, &msg))
	{return false;}

	return true;
}

void calibrate(const struct device* dev, uint8_t* buf, calVals* calibVals)
{
	static bool freshCalib = true;
	static uint16_t aggre;
	static int reads;
	static int avg;

	uint16_t reading = ((uint16_t)(buf[1])<<8) + (uint16_t)(buf[0]);
	bufMsg msg;
	if(freshCalib == true)
	{
		aggre = reading;
		reads = 1; 
		calibVals->ambH = reading+20;
		calibVals->ambL = reading-20;
		freshCalib = false;
		printk("updated ambH to %u\n", calibVals->ambH);
		printk("updated ambL to %u\n", calibVals->ambL);
		return;
	} else {
		aggre += reading;
		reads += 1;
		if (reads > 20)
		{
			avg = aggre/reads;
			aggre = avg;
			reads = 1;
		}
		printk("aggre is %d. avg is %d. \n", aggre, avg);
	}
	if(reading > calibVals->ambH)
	{
		calibVals->ambH = reading;
		printk("updated ambH to %u\n", calibVals->ambH);
		msg.regAddr = VCNL4040_H_THRESH_REG;
		msg.LByte = buf[0]+15;
		msg.HByte = buf[1];
		if(!vcnlWrite(dev, buf, &msg))
		{return;}
	}
	if(reading < calibVals->ambL)
	{
		calibVals->ambL = reading;
		printk("updated ambL to %u\n", calibVals->ambL);
		msg.regAddr = VCNL4040_L_THRESH_REG;
		msg.LByte = buf[0]-15;
		msg.HByte = buf[1];
		if(!vcnlWrite(dev, buf, &msg))
		{return;}
	}
}

void pollALS(const struct device* dev, uint8_t* i2c_buffer)
{
	//poll ALS
	static calVals calibValues; //store highest and lowest ambients
	vcnlRead(dev, i2c_buffer, VCNL4040_ALS_REG);
	calibrate(dev, i2c_buffer, &calibValues);
	if(INTflag == true)
	{
		printk("interrupt was triggered\n");
		vcnlRead(dev, i2c_buffer, VCNL4040_INT_FLAG);
		INTflag = false;
		printk("looking for bluetooth...\n");
		k_msleep(1000);
	}
	printk("bluetooth %s\n", buttonFlag ? "on!" : "off.");
}
```

## src/vcnl4040.h
```c
#ifndef VCNL4040_H_
#define VCNL4040_H_

#define VCNL4040_I2C_ADDR		0x60
#define VCNL4040_H_THRESH_REG	0x01
#define VCNL4040_H_THRESH_H		0x75 //30000
#define VCNL4040_H_THRESH_L		0x30 //0x7530
#define VCNL4040_L_THRESH_REG	0x02
#define VCNL4040_L_THRESH_H		0x00 //63
#define VCNL4040_L_THRESH_L		0x3f
#define VCNL4040_ALS_REG		0x09 //als data
#define VCNL4040_ALS_CONF_REG	0x00
#define VCNL4040_ALS_CONF_SET_L	0b00000010 //7:6 80ms, 5:4 res, 3:2 int persist(1), 1 int on, 0 als on
#define VCNL4040_INT_FLAG 		0x0B
#define VCNL4040_ALS_CONF_SET_H 0b00000000 //7:0 all reserved

typedef struct bufMsg{
	int regAddr; 
	int LByte;
	int HByte;
} bufMsg;

typedef struct calVals{
	uint16_t ambH;
	uint16_t ambL;
} calVals;

bool vcnlWrite(const struct device* dev, uint8_t* i2c_buffer, bufMsg* msg);
bool vcnlRead(const struct device* dev, uint8_t* i2c_buffer, uint8_t reg);
bool sensorSetup(const struct device* dev, uint8_t* i2c_buffer);
void calibrate(const struct device* dev, uint8_t* buf, calVals* calibVals);
void pollALS(const struct device* dev, uint8_t* i2c_buffer);


#endif 
```
